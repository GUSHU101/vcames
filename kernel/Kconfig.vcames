## kernel/Kconfig.vcames
```kconfig
config VIDEO_V4L2LOOPBACK
    tristate "VCamES V4L2 loopback video device"
    depends on VIDEO_DEV
    help
      Build the v4l2loopback device used by VCamES as /dev/video100.
      The driver source is maintained in third_party/v4l2loopback.
```
